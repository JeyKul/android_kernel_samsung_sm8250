## arch/arm64/Kconfig.projects
```kconfig
config SEC_R8Q_PROJECT
	default n
	bool "Samsung R8Q Project"
	help
	  Support for Samsung R8Q Project

config MACH_R8Q_EUR_OPEN
	default n
	bool "Samsung R8Q EUR OPEN"
	help
	  Support for Samsung R8Q EUR OPEN device.

config SEC_GTS7XL_PROJECT
	depends on ARCH_KONA
	default n
	bool "Samsung GTS7XL Project"
	help
	  Support for Samsung GTS7XL Project

config SEC_GTS7L_PROJECT
	depends on ARCH_KONA
	default n
	bool "Samsung GTS7L Project"
	help
	  Support for Samsung GTS7L Project

config MACH_GTS7L_EUR_OPEN
	default n
	bool "Samsung GTS7L EUR OPEN"
	help
	  Support for Samsung GTS7L EUR OPEN device.

config SEC_GTS7XL_PROJECT
	default n
	bool "Samsung GTS7XL Project"
	help
	  Support for Samsung GTS7XL Project

config MACH_GTS7XL_EUR_OPEN
	default n
	bool "Samsung GTS7XL EUR OPEN"
	help
	  Support for Samsung GTS7XL EUR OPEN device.

config MACH_GTS7XLWIFI_EUR_OPEN
	default n
	bool "Samsung GTS7XLWIFI EUR OPEN"
	help
	  Support for Samsung GTS7XLWIFI EUR OPEN device.

config SEC_C2Q_PROJECT
	default n
	bool "Samsung C2Q Project"
	help
	  Support for Samsung C2Q Project

config MACH_C2Q_KOR_SINGLE
	default n
	bool "Samsung C2Q KOR SQ"
	help
	  Support for Samsung C2Q KOR SQ device.
	  
config MACH_GTS7LWIFI_EUR_OPEN
	default n
	bool "Samsung GTS7LWIFI EUR OPEN"
	help
	  Support for Samsung GTS7LWIFI EUR OPEN device.
```
